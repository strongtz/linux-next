## drivers/net/wireless/aic8800/Kconfig
```kconfig
config WLAN_VENDOR_AIC8800
	bool "AIC wireless Support"
	default n
	help
	  This is support for aic wireless chip.

if WLAN_VENDOR_AIC8800
source "drivers/net/wireless/aic8800/aic8800_fdrv/Kconfig"
source "drivers/net/wireless/aic8800/aic_load_fw/Kconfig"
endif
```
